## cnss_prealloc/Kconfig
```kconfig
# SPDX-License-Identifier: GPL-2.0-only

config WCNSS_MEM_PRE_ALLOC
	tristate "WCNSS pre-alloc memory support"
	help
	  Pre-allocate memory for the WLAN driver module.
	  This feature enable cld wlan driver to use pre allocated memory
	  for it's internal usage and release it to back to pre allocated pool.
	  This memory is allocated at the cold boot time.

config WLAN_MEMORY_OPT
        bool "Enable WLAN memory optimization"
        depends on WCNSS_MEM_PRE_ALLOC
        help
	  If enabled, will reduce the count of prealloc memory buffer pool
	  and save memory.
```
